## Software/linux-4.4.179/Documentation/devicetree/bindings/ata/fsl-sata.txt
```
Valid-License-Identifier: CDDL-1.0
SPDX-URL: https://spdx.org/licenses/CDDL-1.0.html
Usage-Guide:
  Do NOT use. The CDDL-1.0 is not GPL compatible. It may only be used for
  dual-licensed files where the other license is GPL compatible.
  If you end up using this it MUST be used together with a GPL2 compatible
  license using "OR".
  To use the Common Development and Distribution License 1.0 put the
  following SPDX tag/value pair into a comment according to the placement
  guidelines in the licensing rules documentation:
    SPDX-License-Identifier: ($GPL-COMPATIBLE-ID OR CDDL-1.0)

License-Text:

COMMON DEVELOPMENT AND DISTRIBUTION LICENSE (CDDL)
Version 1.0

    1. Definitions.

        1.1. "Contributor" means each individual or entity that creates or
             contributes to the creation of Modifications.

        1.2. "Contributor Version" means the combination of the Original
	     Software, prior Modifications used by a Contributor (if 
```

## Software/linux-4.4.179/Documentation/devicetree/bindings/ata/imx-pata.txt
```
Valid-License-Identifier: GPL-1.0+
SPDX-URL: https://spdx.org/licenses/GPL-1.0.html
Usage-Guide:
  The GNU General Public License (GPL) version 1 should not be used in new
  code. For existing kernel code the 'or any later version' option is
  required to be compatible with the general license of the project: GPLv2.
  To use the license in source code, put the following SPDX tag/value pair
  into a comment ac
```

## Software/uClinux-20040218-dist/linux-2.0.x/fs/Config.in
```kconfig
#
# Filesystem configuration
#
mainmenu_option next_comment
comment 'Filesystems'

bool	 'Quota support' CONFIG_QUOTA
tristate 'Minix fs support' CONFIG_MINIX_FS
tristate 'Extended fs support' CONFIG_EXT_FS
tristate 'Second extended fs support' CONFIG_EXT2_FS
tristate 'xiafs filesystem support' CONFIG_XIA_FS

tristate 'Native language support (Needed for FAT and ISO9660)' CONFIG_NLS
if [ "$CONFIG_NLS" = "y" -o "$CONFIG_NLS" = "m" ]; then
   dep_tristate '  ISO9660 cdrom filesystem support' CONFIG_ISO9660_FS $CONFIG_NLS

   # msdos filesystems
   dep_tristate '  DOS FAT fs support' CONFIG_FAT_FS $CONFIG_NLS
   dep_tristate '    MSDOS fs support' CONFIG_MSDOS_FS $CONFIG_FAT_FS
   dep_tristate '      umsdos: Unix like fs on top of std MSDOS FAT fs' CONFIG_UMSDOS_FS $CONFIG_MSDOS_FS
   dep_tristate '      VFAT (Windows-95) fs support' CONFIG_VFAT_FS $CONFIG_FAT_FS
   mainmenu_option next_comment
   comment 'Select available code pages'
   dep_tristate 'Codepage 437 (United States, Canada)'	CONFIG_NLS_CODEPAGE_437 $CONFIG_NLS
   dep_tristate 'Codepage 737 (Greek)'			CONFIG_NLS_CODEPAGE_737 $CONFIG_NLS
   dep_tristate 'Codepage 775 (Baltic Rim)'		CONFIG_NLS_CODEPAGE_775 $CONFIG_NLS
   dep_tristate 'Codepage 850 (Europe)'			CONFIG_NLS_CODEPAGE_850 $CONFIG_NLS
   dep_tristate 'Codepage 852 (Central/Eastern Europe)'	CONFIG_NLS_CODEPAGE_852 $CONFIG_NLS
   dep_tristate 'Codepage 855 (Cyrillic)'		CONFIG_NLS_CODEPAGE_855 $CONFIG_NLS
   dep_tristate 'Codepage 857 (Turkish)'		CONFIG_NLS_CODEPAGE_857 $CONFIG_NLS
   dep_tristate 'Codepage 860 (Portugese)'		CONFIG_NLS_CODEPAGE_860 $CONFIG_NLS
   dep_tristate 'Codepage 861 (Icelandic)'		CONFIG_NLS_CODEPAGE_861 $CONFIG_NLS
   dep_tristate 'Codepage 862 (Hebrew)'			CONFIG_NLS_CODEPAGE_862 $CONFIG_NLS
   dep_tristate 'Codepage 863 (Canadian French)'	CONFIG_NLS_CODEPAGE_863 $CONFIG_NLS
   dep_tristate 'Codepage 864 (Arabic)'			CONFIG_NLS_CODEPAGE_864 $CONFIG_NLS
   dep_tristate 'Codepage 865 (Nordic European)'	CONFIG_NLS_CODEPAGE_865 $CONFIG_NLS
   dep_tristate 'Codepage 866 (Cyrillic/Russian)'	CONFIG_NLS_CODEPAGE_866 $CONFIG_NLS
   dep_tristate 'Codepage 869 (Greek)'			CONFIG_NLS_CODEPAGE_869 $CONFIG_NLS
   dep_tristate 'Codepage 874 (Thai)'			CONFIG_NLS_CODEPAGE_874 $CONFIG_NLS
   dep_tristate 'NLS ISO 8859-1 (Latin 1; Western Europe)'    CONFIG_NLS_ISO8859_1    $CONFIG_NLS 
   dep_tristate 'NLS ISO 8859-2 (Latin 2; Slavic/Central European)'    CONFIG_NLS_ISO8859_2    $CONFIG_NLS
   dep_tristate 'NLS ISO 8859-3 (Latin 3; Esperanto, Galician, Maltese, Turkish)'    CONFIG_NLS_ISO8859_3    $CONFIG_NLS
   dep_tristate 'NLS ISO 8859-4 (Latin 4; Estonian, Latvian, Lithuanian)'    CONFIG_NLS_ISO8859_4    $CONFIG_NLS
   dep_tristate 'NLS ISO 8859-5 (Cyrillic)'    CONFIG_NLS_ISO8859_5    $CONFIG_NLS
   dep_tristate 'NLS ISO 8859-6 (Arabic)'    CONFIG_NLS_ISO8859_6    $CONFIG_NLS
   dep_tristate 'NLS ISO 8859-7 (Modern Greek)'    CONFIG_NLS_ISO8859_7    $CONFIG_NLS
   dep_tristate 'NLS ISO 8859-8 (Hebrew)'    CONFIG_NLS_ISO8859_8    $CONFIG_NLS
   dep_tristate 'NLS ISO 8859-9 (Latin 5; Turkey)'    CONFIG_NLS_ISO8859_9    $CONFIG_NLS
   dep_tristate 'NLS ISO 8859-14 (Latin 8; Celtic)'      CONFIG_NLS_ISO8859_14 $CONFIG_NLS
   dep_tristate 'NLS ISO 8859-15 (Latin 9; Western European Languages with Euro)' CONFIG_NLS_ISO8859_15 $CONFIG_NLS
   dep_tristate 'NLS KOI8-R (Russian)'        CONFIG_NLS_KOI8_R       $CONFIG_NLS
   endmenu
fi

bool '/proc filesystem support' CONFIG_PROC_FS
if [ "$CONFIG_INET" = "y" ]; then
   tristate 'NFS filesystem support' CONFIG_NFS_FS
   if [ "$CONFIG_NFS_FS" = "y" ]; then
      bool '  Root file system on NFS' CONFIG_ROOT_NFS
      if [ "$CONFIG_ROOT_NFS" = "y" ]; then
	 bool '    BOOTP support' CONFIG_RNFS_BOOTP
	 bool '    RARP support' CONFIG_RNFS_RARP
      fi
   fi
   tristate 'SMB filesystem support (to mount WfW shares etc..)' CONFIG_SMB_FS
   if [ "$CONFIG_SMB_FS" != "n" ]; then
      bool '  SMB Win95 bug work-around' CONFIG_SMB_WIN95
   fi
fi
if [ "$CONFIG_IPX" != "n" ]; then
   tristate 'NCP filesystem support (to mount NetWare volumes)' CONFIG_NCP_FS
   if [ "$CONFIG_NCP_FS" != "n" ]; then
      source fs/ncpfs/Config.in
   fi
fi
tristate 'OS/2 HPFS filesystem support (read only)' CONFIG_HPFS_FS
tristate 'System V and Coherent filesystem support' CONFIG_SYSV_FS
if [ "$CONFIG_EXPERIMENTAL" = "y" ]; then
   tristate 'Kernel automounter support (EXPERIMENTAL)' CONFIG_AUTOFS_FS
fi
if [ "$CONFIG_EXPERIMENTAL" = "y" ]; then
   tristate 'Amiga FFS filesystem support (EXPERIMENTAL)' CONFIG_AFFS_FS
   if [ "$CONFIG_AFFS_FS" != "n" ]; then
      define_bool CONFIG_AMIGA_PARTITION y
   fi
fi
tristate 'ROM filesystem support' CONFIG_ROMFS_FS
tristate 'Journaling FLASH filesystem support' CONFIG_JFFS_FS
tristate 'UFS filesystem support (read only)' CONFIG_UFS_FS
if [ "$CONFIG_UFS_FS" != "n" ]; then
   bool '  BSD disklabel (FreeBSD partition tables) support' CONFIG_BSD_DISKLABEL
   bool '  SMD disklabel (Sun partition tables) support' CONFIG_SMD_DISKLABEL
fi
endmenu
```

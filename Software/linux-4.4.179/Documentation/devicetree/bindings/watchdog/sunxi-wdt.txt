## Software/linux-4.4.179/Documentation/devicetree/bindings/watchdog/sunxi-wdt.txt
```
// SPDX-License-Identifier: GPL-2.0
#include "qcom-apq8064-v2.0.dtsi"
#include <dt-bindings/gpio/gpio.h>
#include <dt-bindings/input/input.h>
#include <dt-bindings/mfd/qcom-rpm.h>
#include <dt-bindings/pinctrl/qcom,pmic-gpio.h>

/ {
	model = "Sony Xperia Z";
	compatible = "sony,xperia-yuga", "qcom,apq8064";

	aliases {
		seria
```

## Software/linux-4.4.179/Documentation/devicetree/bindings/x86/ce4100.txt
```
// SPDX-License-Identifier: GPL-2.0
/dts-v1/;

#include "skeleton.dtsi"
#include <dt-bindings/clock/qcom,gcc-msm8960.h>
#include <dt-bindings/reset/qcom,gcc-msm8960.h>
#include <dt-bindings/clock/qcom,mmcc-msm8960.h>
#include <dt-bindings/clock/qcom,rpmcc.h>
#include <dt-bindings/soc/qcom,gsbi.h>
#include <dt-bindings/interrupt-controller/irq.h>
#include <dt-bindings/interrupt-controller/arm-gic.h>
/ {
	model = "Qualcomm APQ8064";
	compatible = "qcom,apq8064";
	interrupt-parent = <&intc>;

	reserved-memory {
		#address-cells = <1>;
		#size-cells = <1>;
		ranges;

		smem_region: smem@80000000 {
			reg = <0x80000000 0x200000>;
			no-map;
		};

		wcnss_mem: wcnss@8f000000 {
			reg = <0x8f000000 0x700000>;
			no-map;
		};
	};

	cpus {
		#address-cells = <1>;
		#size-cells = <0>;

		CPU0: cpu@0 {
			compatible = "qcom,krait";
			enable-method = "qcom,kpss-acc-v1";
			device_type = "cpu";
			reg = <0>;
			next-level-cache = <&L2>;
			qcom,acc = <&acc0>;
			qcom,saw = <&saw0>;
			cpu-idle-states = <&CPU_SPC>;
		};

		CPU1: cpu@1 {
			compatible = "qcom,krait";
			enable-method = "qcom,kpss-acc-v1";
			device_type = "cpu";
			reg = <1>;
			next-level-cache = <&L2>;
			qcom,acc = <&acc1>;
			qcom,saw = <
```

## Software/uClinux-20040218-dist/config.in
```kconfig
mainmenu_name 'SnapGear Embedded Linux Configuration'
mainmenu_option next_comment
comment 'Vendor/Product Selection'
comment 'Select the Vendor you wish to target'
choice 'Vendor' "3com CONFIG_DEFAULTS_3COM \
ADI CONFIG_DEFAULTS_ADI \
Arcturus CONFIG_DEFAULTS_ARCTURUS \
Arnewsh CONFIG_DEFAULTS_ARNEWSH \
Artyom CONFIG_DEFAULTS_ARTYOM \
Atmel CONFIG_DEFAULTS_ATMEL \
BMOW CONFIG_DEFAULTS_BMOW \
Conexant CONFIG_DEFAULTS_CONEXANT \
Cwlinux CONFIG_DEFAULTS_CWLINUX \
Cytek CONFIG_DEFAULTS_CYTEK \
Exys CONFIG_DEFAULTS_EXYS \
Feith CONFIG_DEFAULTS_FEITH \
Future CONFIG_DEFAULTS_FUTURE \
GDB CONFIG_DEFAULTS_GDB \
Hitachi CONFIG_DEFAULTS_HITACHI \
Imt CONFIG_DEFAULTS_IMT \
Insight CONFIG_DEFAULTS_INSIGHT \
Intel CONFIG_DEFAULTS_INTEL \
KendinMicrel CONFIG_DEFAULTS_KENDINMICREL \
LEOX CONFIG_DEFAULTS_LEOX \
Mecel CONFIG_DEFAULTS_MECEL \
Midas CONFIG_DEFAULTS_MIDAS \
Motorola CONFIG_DEFAULTS_MOTOROLA \
NEC CONFIG_DEFAULTS_NEC \
Netburner CONFIG_DEFAULTS_NETBURNER \
NetSilicon CONFIG_DEFAULTS_NETSILICON \
Nintendo CONFIG_DEFAULTS_NINTENDO \
OPENcores CONFIG_DEFAULTS_OPENCORES \
Promise CONFIG_DEFAULTS_PROMISE \
Samsung CONFIG_DEFAULTS_SAMSUNG \
SecureEdge CONFIG_DEFAULTS_SECUREEDGE \
senTec CONFIG_DEFAULTS_SENTEC \
SnapGear CONFIG_DEFAULTS_SNAPGEAR \
Soekris CONFIG_DEFAULTS_SOEKRIS \
SSV CONFIG_DEFAULTS_SSV \
SWARM CONFIG_DEFAULTS_SWARM \
TeleIP CONFIG_DEFAULTS_TELEIP \
Triscend CONFIG_DEFAULTS_TRISCEND \
Via CONFIG_DEFAULTS_VIA \
Weiss CONFIG_DEFAULTS_WEISS \
Xilinx CONFIG_DEFAULTS_XILINX \
" SnapGear
comment 'Select the Product you wish to target'
if [ "$CONFIG_DEFAULTS_3COM" = "y" ]; then
choice '3com Products' "PalmIIIx CONFIG_DEFAULTS_3COM_PALMIIIX \
Xcopilot CONFIG_DEFAULTS_3COM_XCOPILOT \
" PalmIIIx
fi
if [ "$CONFIG_DEFAULTS_ADI" = "y" ]; then
choice 'ADI Products' "Coyote CONFIG_DEFAULTS_ADI_COYOTE \
" Coyote
fi
if [ "$CONFIG_DEFAULTS_ARCTURUS" = "y" ]; then
choice 'Arcturus Products' "uC5272 CONFIG_DEFAULTS_ARCTURUS_UC5272 \
uCdimm CONFIG_DEFAULTS_ARCTURUS_UCDIMM \
uCdimm+mtd CONFIG_DEFAULTS_ARCTURUS_UCDIMM_MTD \
uCquicc CONFIG_DEFAULTS_ARCTURUS_UCQUICC \
uCsimm CONFIG_DEFAULTS_ARCTURUS_UCSIMM \
" uC5272
fi
if [ "$CONFIG_DEFAULTS_ARNEWSH" = "y" ]; then
choice 'Arnewsh Products' "M5206 CONFIG_DEFAULTS_ARNEWSH_M5206 \
M5307 CONFIG_DEFAULTS_ARNEWSH_M5307 \
" M5206
fi
if [ "$CONFIG_DEFAULTS_ARTYOM" = "y" ]; then
choice 'Artyom Products' "Blitz CONFIG_DEFAULTS_ARTYOM_BLITZ \
" Blitz
fi
if [ "$CONFIG_DEFAULTS_ATMEL" = "y" ]; then
choice 'Atmel Products' "AT91 CONFIG_DEFAULTS_ATMEL_AT91 \
" AT91
fi
if [ "$CONFIG_DEFAULTS_BMOW" = "y" ]; then
choice 'BMOW Products' "68Katy CONFIG_DEFAULTS_BMOW_68KATY \
" 68Katy
fi
if [ "$CONFIG_DEFAULTS_CONEXANT" = "y" ]; then
choice 'Conexant Products' "Humber CONFIG_DEFAULTS_CONEXANT_HUMBER \
P52 CONFIG_DEFAULTS_CONEXANT_P52 \
" Humber
fi
if [ "$CONFIG_DEFAULTS_CWLINUX" = "y" ]; then
choice 'Cwlinux Products' "cwez328 CONFIG_DEFAULTS_CWLINUX_CWEZ328 \
cwvz328 CONFIG_DEFAULTS_CWLINUX_CWVZ328 \
" cwez328
fi
if [ "$CONFIG_DEFAULTS_CYTEK" = "y" ]; then
choice 'Cytek Products' "NETmp3 CONFIG_DEFAULTS_CYTEK_NETMP3 \
" NETmp3
fi
if [ "$CONFIG_DEFAULTS_EXYS" = "y" ]; then
choice 'Exys Products' "de2 CONFIG_DEFAULTS_EXYS_DE2 \
" de2
fi
if [ "$CONFIG_DEFAULTS_FEITH" = "y" ]; then
choice 'Feith Products' "Cleopatra2 CONFIG_DEFAULTS_FEITH_CLEOPATRA2 \
Cleopatra CONFIG_DEFAULTS_FEITH_CLEOPATRA \
" Cleopatra2
fi
if [ "$CONFIG_DEFAULTS_FUTURE" = "y" ]; then
choice 'Future Products' "FutureNetburner5282Badge CONFIG_DEFAULTS_FUTURE_FUTURENETBURNER5282BADGE \
" FutureNetburner5282Badge
fi
if [ "$CONFIG_DEFAULTS_GDB" = "y" ]; then
choice 'GDB Products' "ARMulator CONFIG_DEFAULTS_GDB_ARMULATOR \
ARMulator-EB CONFIG_DEFAULTS_GDB_ARMULATOR_EB \
" ARMulator
fi
if [ "$CONFIG_DEFAULTS_HITACHI" = "y" ]; then
choice 'Hitachi Products' "BigSurIV CONFIG_DEFAULTS_HITACHI_BIGSURIV \
EDOSK2674 CONFIG_DEFAULTS_HITACHI_EDOSK2674 \
KeyWest CONFIG_DEFAULTS_HITACHI_KEYWEST \
" BigSurIV
fi
if [ "$CONFIG_DEFAULTS_IMT" = "y" ]; then
choice 'Imt Products' "mwi CONFIG_DEFAULTS_IMT_MWI \
" mwi
fi
if [ "$CONFIG_DEFAULTS_INSIGHT" = "y" ]; then
choice 'Insight Products' "mbvanilla_net CONFIG_DEFAULTS_INSIGHT_MBVANILLA_NET \
XC2V1K_Microblaze CONFIG_DEFAULTS_INSIGHT_XC2V1K_MICROBLAZE \
XC2VP7_Microblaze CONFIG_DEFAULTS_INSIGHT_XC2VP7_MICROBLAZE \
" mbvanilla_net
fi
if [ "$CONFIG_DEFAULTS_INTEL" = "y" ]; then
choice 'Intel Products' "IXDP425 CONFIG_DEFAULTS_INTEL_IXDP425 \
" IXDP425
fi
if [ "$CONFIG_DEFAULTS_KENDINMICREL" = "y" ]; then
choice 'KendinMicrel Products' "KS8695 CONFIG_DEFAULTS_KENDINMICREL_KS8695 \
" KS8695
fi
if [ "$CONFIG_DEFAULTS_LEOX" = "y" ]; then
choice 'LEOX Products' "TSIM CONFIG_DEFAULTS_LEOX_TSIM \
" TSIM
fi
if [ "$CONFIG_DEFAULTS_MECEL" = "y" ]; then
choice 'Mecel Products' "FR1000 CONFIG_DEFAULTS_MECEL_FR1000 \
" FR1000
fi
if [ "$CONFIG_DEFAULTS_MIDAS" = "y" ]; then
choice 'Midas Products' "RTE-NB85E-CB CONFIG_DEFAULTS_MIDAS_RTE_NB85E_CB \
RTE-V850E-MA1-CB CONFIG_DEFAULTS_MIDAS_RTE_V850E_MA1_CB \
RTE-V850E-ME2-CB CONFIG_DEFAULTS_MIDAS_RTE_V850E_ME2_CB \
" RTE-NB85E-CB
fi
if [ "$CONFIG_DEFAULTS_MOTOROLA" = "y" ]; then
choice 'Motorola Products' "M5206eC3 CONFIG_DEFAULTS_MOTOROLA_M5206EC3 \
M5206eLITE CONFIG_DEFAULTS_MOTOROLA_M5206ELITE \
M5249C3 CONFIG_DEFAULTS_MOTOROLA_M5249C3 \
M5272C3 CONFIG_DEFAULTS_MOTOROLA_M5272C3 \
M5282C3 CONFIG_DEFAULTS_MOTOROLA_M5282C3 \
M5307C3 CONFIG_DEFAULTS_MOTOROLA_M5307C3 \
M5407C3 CONFIG_DEFAULTS_MOTOROLA_M5407C3 \
" M5206eC3
fi
if [ "$CONFIG_DEFAULTS_NEC" = "y" ]; then
choice 'NEC Products' "Anna CONFIG_DEFAULTS_NEC_ANNA \
common CONFIG_DEFAULTS_NEC_COMMON \
v850e-sim-gdb CONFIG_DEFAULTS_NEC_V850E_SIM_GDB \
" Anna
fi
if [ "$CONFIG_DEFAULTS_NETBURNER" = "y" ]; then
choice 'Netburner Products' "CFV240 CONFIG_DEFAULTS_NETBURNER_CFV240 \
MOD5282 CONFIG_DEFAULTS_NETBURNER_MOD5282 \
" CFV240
fi
if [ "$CONFIG_DEFAULTS_NETSILICON" = "y" ]; then
choice 'NetSilicon Products' "NET+ARM CONFIG_DEFAULTS_NETSILICON_NET_ARM \
" NET+ARM
fi
if [ "$CONFIG_DEFAULTS_NINTENDO" = "y" ]; then
choice 'Nintendo Products' "GBA CONFIG_DEFAULTS_NINTENDO_GBA \
" GBA
fi
if [ "$CONFIG_DEFAULTS_OPENCORES" = "y" ]; then
choice 'OPENcores Products' "or32 CONFIG_DEFAULTS_OPENCORES_OR32 \
" or32
fi
if [ "$CONFIG_DEFAULTS_PROMISE" = "y" ]; then
choice 'Promise Products' "SX6 CONFIG_DEFAULTS_PROMISE_SX6 \
" SX6
fi
if [ "$CONFIG_DEFAULTS_SAMSUNG" = "y" ]; then
choice 'Samsung Products' "4510B CONFIG_DEFAULTS_SAMSUNG_4510B \
" 4510B
fi
if [ "$CONFIG_DEFAULTS_SECUREEDGE" = "y" ]; then
choice 'SecureEdge Products' "DISKtel CONFIG_DEFAULTS_SECUREEDGE_DISKTEL \
eLIA CONFIG_DEFAULTS_SECUREEDGE_ELIA \
MP3 CONFIG_DEFAULTS_SECUREEDGE_MP3 \
NETtel1500 CONFIG_DEFAULTS_SECUREEDGE_NETTEL1500 \
NETtel3540 CONFIG_DEFAULTS_SECUREEDGE_NETTEL3540 \
SecureEdge1100 CONFIG_DEFAULTS_SECUREEDGE_SECUREEDGE1100 \
SecureEdge2540 CONFIG_DEFAULTS_SECUREEDGE_SECUREEDGE2540 \
SecureEdge2570 CONFIG_DEFAULTS_SECUREEDGE_SECUREEDGE2570 \
SecureEdge2580 CONFIG_DEFAULTS_SECUREEDGE_SECUREEDGE2580 \
SecureEdge2580-JFFS CONFIG_DEFAULTS_SECUREEDGE_SECUREEDGE2580_JFFS \
SecureEdgeEdna CONFIG_DEFAULTS_SECUREEDGE_SECUREEDGEEDNA \
SecureEdgeNAS CONFIG_DEFAULTS_SECUREEDGE_SECUREEDGENAS \
SecureEdgePCMCIA CONFIG_DEFAULTS_SECUREEDGE_SECUREEDGEPCMCIA \
SecureEdgeVPN CONFIG_DEFAULTS_SECUREEDGE_SECUREEDGEVPN \
" DISKtel
fi
if [ "$CONFIG_DEFAULTS_SENTEC" = "y" ]; then
choice 'senTec Products' "COBRA5272 CONFIG_DEFAULTS_SENTEC_COBRA5272 \
" COBRA5272
fi
if [ "$CONFIG_DEFAULTS_SNAPGEAR" = "y" ]; then
choice 'SnapGear Products' "LITE300 CONFIG_DEFAULTS_SNAPGEAR_LITE300 \
LITE CONFIG_DEFAULTS_SNAPGEAR_LITE \
PRO CONFIG_DEFAULTS_SNAPGEAR_PRO \
SE2910-Intel CONFIG_DEFAULTS_SNAPGEAR_SE2910_INTEL \
SE3400 CONFIG_DEFAULTS_SNAPGEAR_SE3400 \
SE4000 CONFIG_DEFAULTS_SNAPGEAR_SE4000 \
SME530 CONFIG_DEFAULTS_SNAPGEAR_SME530 \
SME550 CONFIG_DEFAULTS_SNAPGEAR_SME550 \
SME570 CONFIG_DEFAULTS_SNAPGEAR_SME570 \
SOHO+ CONFIG_DEFAULTS_SNAPGEAR_SOHO_ \
" LITE300
fi
if [ "$CONFIG_DEFAULTS_SOEKRIS" = "y" ]; then
choice 'Soekris Products' "net4801 CONFIG_DEFAULTS_SOEKRIS_NET4801 \
" net4801
fi
if [ "$CONFIG_DEFAULTS_SSV" = "y" ]; then
choice 'SSV Products' "DNP5280 CONFIG_DEFAULTS_SSV_DNP5280 \
" DNP5280
fi
if [ "$CONFIG_DEFAULTS_SWARM" = "y" ]; then
choice 'SWARM Products' "SWARM CONFIG_DEFAULTS_SWARM_SWARM \
" SWARM
fi
if [ "$CONFIG_DEFAULTS_TELEIP" = "y" ]; then
choice 'TeleIP Products' "rsc CONFIG_DEFAULTS_TELEIP_RSC \
" rsc
fi
if [ "$CONFIG_DEFAULTS_TRISCEND" = "y" ]; then
choice 'Triscend Products' "A7DB CONFIG_DEFAULTS_TRISCEND_A7DB \
DevA7 CONFIG_DEFAULTS_TRISCEND_DEVA7 \
" A7DB
fi
if [ "$CONFIG_DEFAULTS_VIA" = "y" ]; then
choice 'Via Products' "EPIA CONFIG_DEFAULTS_VIA_EPIA \
" EPIA
fi
if [ "$CONFIG_DEFAULTS_WEISS" = "y" ]; then
choice 'Weiss Products' "SM2010 CONFIG_DEFAULTS_WEISS_SM2010 \
" SM2010
fi
if [ "$CONFIG_DEFAULTS_XILINX" = "y" ]; then
choice 'Xilinx Products' "common CONFIG_DEFAULTS_XILINX_COMMON \
" common
fi
endmenu
mainmenu_option next_comment
comment 'Kernel/Library/Defaults Selection'
choice 'Kernel Version' "linux-2.0.x CONFIG_DEFAULTS_KERNEL_2_0 \
linux-2.4.x CONFIG_DEFAULTS_KERNEL_2_4 \
linux-2.6.x CONFIG_DEFAULTS_KERNEL_2_6 \
" linux-2.6.x
choice 'Libc Version' "glibc CONFIG_DEFAULTS_LIBC_GLIBC \
uC-libc CONFIG_DEFAULTS_LIBC_UC_LIBC \
uClibc CONFIG_DEFAULTS_LIBC_UCLIBC \
" uClibc
bool 'Default all settings (lose changes)'	CONFIG_DEFAULTS_OVERRIDE
bool 'Customize Kernel Settings'			CONFIG_DEFAULTS_KERNEL
bool 'Customize Vendor/User Settings'		CONFIG_DEFAULTS_VENDOR
bool 'Update Default Vendor Settings'		CONFIG_DEFAULTS_VENDOR_UPDATE
endmenu
```
